## CMakeLists.txt
```
# SPDX-License-Identifier: Apache-2.0

cmake_minimum_required(VERSION 3.20.0)
find_package(Zephyr REQUIRED HINTS $ENV{ZEPHYR_BASE})
project(morse_tap)

include_directories(${CMAKE_SOURCE_DIR}/include)
target_sources(app PRIVATE src/main.cpp src/morse.cpp
               src/led_signaler.cpp src/pin_reader.cpp
               src/uart_publisher.cpp)
```

## prj.conf
```kconfig
CONFIG_GPIO=y
CONFIG_CPP=y
CONFIG_NEWLIB_LIBC=y
CONFIG_LIB_CPLUSPLUS=y
CONFIG_EVENTS=y
CONFIG_LEGACY_GENERATED_INCLUDE_PATH=y
CONFIG_TIMESLICING=y
CONFIG_SERIAL=y
CONFIG_UART_ASYNC_API=y
CONFIG_UART_INTERRUPT_DRIVEN=y
```

## stm32f4_disco.overlay
```dts
 {
	aliases {
		led0 = &led0;
	};

	leds {
		compatible = "gpio-leds";
		led0: led_0 {
			gpios = <&gpio0 25 GPIO_ACTIVE_HIGH>;
			label = "LED 0";
		};
	};
};
```

## src/main.cpp
```c
/*
 * Copyright (c) 2016 Intel Corporation
 *
 * SPDX-License-Identifier: Apache-2.0
 */
#include <string>

#include <zephyr/kernel.h>
#include <zephyr/drivers/gpio.h>
#include <zephyr/drivers/uart.h>

#include "pin_reader.hpp"
#include "led_signaler.hpp"
#include "uart_publisher.hpp"


void pin_reader_entry(k_timer* timer);
void led_signaler_entry(k_timer* timer);
// void uart_publisher_entry(k_timer* timer);

#define THREAD_STACK_SIZE 8192
#define INPUT_PIN 11
#define LED_PIN 13
#define MSGQ_BUFFER_SIZE 8

static const struct device * gpiob = DEVICE_DT_GET(DT_NODELABEL(gpiob));
static const struct device * gpiod = DEVICE_DT_GET(DT_NODELABEL(gpiod));
static const struct device * usart1 = DEVICE_DT_GET(DT_NODELABEL(usart1));


static char rx_buf[morse::MAX_CHARS_WORD];
static int rx_buf_pos = 0;

k_timer pin_read_timer, led_signal_timer, uart_publish_timer, injection_check_timer;

char uart_msgq_buffer[MSGQ_BUFFER_SIZE * morse::MAX_CHARS_WORD * sizeof(char)];
char led_msgq_buffer[MSGQ_BUFFER_SIZE * morse::MAX_CHARS_WORD * sizeof(char)];
k_msgq led_msgq, uart_msgq;

PinReader reader(INPUT_PIN, gpiob, &led_msgq, &uart_msgq);
LedSignaler signaler(LED_PIN, gpiod, &led_msgq);
UartPublisher publisher(usart1, &uart_msgq);

void irq_rx_uart(k_timer* timer)
{
	uint8_t c;
	if ((!uart_irq_update(usart1)) || !uart_irq_rx_ready(usart1)) {
		return;
	}
	while (uart_fifo_read(usart1, &c, 1) == 1) {
		if ((c == '\n') && rx_buf_pos > 0) {
			rx_buf[rx_buf_pos] = '\0';
			rx_buf_pos = 0;

			k_msgq_put(&uart_msgq, &rx_buf, K_NO_WAIT);
			k_msgq_put(&led_msgq, &rx_buf, K_NO_WAIT);
		} else if (rx_buf_pos < (sizeof(rx_buf) - 1)) {
			rx_buf[rx_buf_pos++] = c;
		}
	}
}

/**
 * @brief Reads and records a bit from the input pin.
 * If the bit completes a word then it starts transmitting it.
 * 
 * @param timer The timer for the pin reads.
 */
void pin_reader_callback(k_timer* timer){
	reader.callback();
}

/**
 * @brief toggles a bit using the led if a word is being signaled.
 * Then checks if a new word has been transmitted by the reader.
 * 
 * @param timer The timer for the led signals.
 */
void led_signaler_callback(k_timer* timer){
	signaler.callback();
}

/**
 * @brief Checks for words transmitted by the reader and published them.
 *
 * @param timer The timer for the uart transmittions.
 */
void uart_publisher_callback(k_timer* timer){
	publisher.callback();
}

/**
 * Configures the uart device, and the input, and output morse pins.
 */
void configure_devices(){
	gpio_pin_configure(gpiod, LED_PIN, GPIO_OUTPUT);
	gpio_pin_configure(gpiob, INPUT_PIN, GPIO_INPUT);

	struct uart_config uart_cfg = {
        .baudrate = 9600,
        .parity   = UART_CFG_PARITY_NONE,
        .stop_bits = UART_CFG_STOP_BITS_1,
        .data_bits = UART_CFG_DATA_BITS_8,
        .flow_ctrl = UART_CFG_FLOW_CTRL_NONE
    };
    uart_configure(usart1, &uart_cfg); 
}

int main(void)
{
	configure_devices();

	k_timer_init(&pin_read_timer, pin_reader_callback, NULL);
	k_timer_init(&led_signal_timer, led_signaler_callback, NULL);
	k_timer_init(&uart_publish_timer, uart_publisher_callback, NULL);
	k_timer_init(&injection_check_timer, irq_rx_uart, NULL);

	k_msgq_init(&led_msgq, led_msgq_buffer, sizeof(char) * morse::MAX_CHARS_WORD, MSGQ_BUFFER_SIZE);
	k_msgq_init(&uart_msgq, uart_msgq_buffer, sizeof(char) * morse::MAX_CHARS_WORD, MSGQ_BUFFER_SIZE);

	k_timer_start(&pin_read_timer, K_MSEC(morse::TIME_UNIT / 2), K_MSEC(morse::TIME_UNIT));
	k_timer_start(&led_signal_timer, K_MSEC(morse::TIME_UNIT / 2), K_MSEC(morse::TIME_UNIT));
	k_timer_start(&uart_publish_timer, K_MSEC(morse::TIME_UNIT / 2), K_MSEC(morse::TIME_UNIT));	
	k_timer_start(&injection_check_timer, K_MSEC(morse::TIME_UNIT / 2), K_MSEC(morse::TIME_UNIT));
	uart_irq_rx_enable(usart1);
	while(1){
	}
	
	return 0;
}
```

## include/led_signaler.hpp
```c
#ifndef __LED_SIGNALER_HPP_
#define __LED_SIGNALER_HPP_

#include <bitset>

#include <zephyr/kernel.h>
#include <zephyr/drivers/gpio.h>

#include <morse.hpp>

class LedSignaler
{
public:
    LedSignaler(uint32_t pin, const struct device * dev, k_msgq* p1);

    ~LedSignaler() = default;

    // Starts listening to input msgq and publishing to led.
	void callback();

private:

    uint32_t m_pin_number;
	const struct device * m_device;
	k_msgq* m_msgq;

    // Currently signaled word, index in word, remaining 1s,
    // and remaining zeroes to publish after the word.
    std::bitset<morse::MAX_BITS_WORD> m_current_word;
    size_t m_index;
    size_t m_remaining;
    size_t m_remaining_zeroes;
};

#endif /*__LED_SIGNALER_HPP_*/
```

## include/morse.hpp
```c
#ifndef __MORSE_HPP__
#define __MORSE_HPP__

#include <bitset>
#include <array>
#include <vector>


namespace morse{

    constexpr const size_t MAX_BITS_WORD = (1 << 8);
    constexpr const size_t MAX_CHARS_WORD = 12;

    constexpr const size_t TIME_UNIT = 50;

    constexpr const size_t SPACE = 1;
    constexpr const size_t DOT = 1;
    constexpr const size_t LINE = 3;

    constexpr const size_t END_CHARACTER = 3;
    constexpr const size_t END_WORD = 7;


    // Converts a SINGLE word from morse to english.
    // Empty morse converts to empty string.
    std::array<char, MAX_CHARS_WORD> morse_to_english(const std::bitset<MAX_BITS_WORD>& morse);

    // Converts a SINGLE word from english to morse.
    std::bitset<MAX_BITS_WORD> english_to_morse(const std::array<char, MAX_CHARS_WORD>& word);


}

#endif
```

## include/pin_reader.hpp
```c
#ifndef __PIN_READER_HPP__
#define __PIN_READER_HPP__

#include <bitset>
#include <stdint.h>

#include <zephyr/kernel.h>
#include <zephyr/drivers/gpio.h>

#include <morse.hpp>


class PinReader
{
public:
	PinReader(uint32_t pin, const struct device * dev, k_msgq* p1, k_msgq * p2);

	~PinReader() = default;

    // Reads bit from input pin, and transmitts a ready word if there is one.
	void callback();

private:
    void _transmit_word(const std::array<char, morse::MAX_CHARS_WORD>& word);

	uint32_t m_pin_number;
	const struct device * m_device;
	k_msgq* m_msgq_1;
	k_msgq* m_msgq_2;

	std::bitset<morse::MAX_BITS_WORD> m_current_word;
	size_t m_low_count;
    size_t m_index;

};


#endif
```

## include/uart_publisher.hpp
```c
#ifndef __UART_PUBLISHER_HPP__
#define __UART_PUBLISHER_HPP__

#include <zephyr/kernel.h>
#include <zephyr/drivers/gpio.h>


class UartPublisher
{
public:
    UartPublisher(const struct device * dev, k_msgq* p1);
    ~UartPublisher() = default;

    void callback();
private:
    const struct device * m_dev;
    k_msgq* m_msgq;
};



#endif /* __UART_PUBLISHER_HPP__ */
```

## src/led_signaler.cpp
```c
#include "led_signaler.hpp"

LedSignaler::LedSignaler(uint32_t pin, const struct device * dev, k_msgq* p1):
m_pin_number(pin), m_device(dev), m_msgq(p1),
m_current_word(), m_index(0), m_remaining(0){}


void LedSignaler::callback(){

    if(m_remaining_zeroes > 0){
        gpio_pin_set(m_device, m_pin_number, 0);
        --m_remaining_zeroes;
    }
    if (0 == m_remaining_zeroes) {
        if(m_remaining > 0){
            if (m_current_word[m_index++]){
                --m_remaining;
                gpio_pin_set(m_device, m_pin_number, 1);
            }   else    {
                gpio_pin_set(m_device, m_pin_number, 0);
            }
            if(0 == m_remaining){
                m_remaining_zeroes = morse::END_WORD;
            }
        }   else if (0 == m_remaining) {
            std::array<char, morse::MAX_CHARS_WORD> received_word = { 0 };
            k_msgq_get(m_msgq, received_word.data(), K_NO_WAIT);
            m_current_word = morse::english_to_morse(received_word);
            m_index = 0;
            m_remaining = m_current_word.count();
        }
    }
}
```

## src/morse.cpp
```c
#include "morse.hpp"


namespace morse {

constexpr const size_t BEEPS_LETTER = 4;
constexpr const size_t ENGLISH_LETTERS = 26;

static constexpr const std::array<char, ENGLISH_LETTERS> english_letters = {
    'A',
    'B',
    'C',
    'D',
    'E',
    'F',
    'G',
    'H',
    'I',
    'J',
    'K',
    'L',
    'M',
    'N',
    'O',
    'P',
    'Q',
    'R',
    'S',
    'T',
    'U',
    'V',
    'W',
    'X',
    'Y',
    'Z',
};

static constexpr const std::array<std::array<size_t, BEEPS_LETTER>, ENGLISH_LETTERS> ITU = {{
    {1, 3, 0, 0},
    {3, 1, 1, 1},
    {3, 1, 3, 1},
    {3, 1, 1, 0},
    {1, 0, 0, 0},
    {1, 1, 3, 1},
    {3, 3, 1, 0},
    {1, 1, 1, 1},
    {1, 1, 0, 0},
    {1, 3, 3, 3},
    {3, 1, 3, 0},
    {1, 3, 1, 1},
    {3, 3, 0, 0},
    {3, 1, 0, 0},
    {3, 3, 3, 0},
    {1, 3, 3, 1},
    {3, 3, 1, 3},
    {1, 3, 1, 0},
    {1, 1, 1, 0},
    {3, 0, 0, 0},
    {1, 1, 3, 0},
    {1, 1, 1, 3},
    {1, 3, 3, 0},
    {3, 1, 1, 3},
    {3, 1, 3, 3},
    {3, 3, 1, 1},
}};


char _ITU_to_english(const std::array<size_t, BEEPS_LETTER>& itu){
    for (size_t i = 0 ; i < ENGLISH_LETTERS ; ++i){
        if (itu == ITU[i]){
            return english_letters[i];
        }
    }
    return 0;
}

std::array<size_t, BEEPS_LETTER> _english_to_ITU(char ch){
    for (size_t i = 0 ; i < ENGLISH_LETTERS ; ++i){
        if (ch == english_letters[i]){
            return ITU[i];
        }
    }
    return {0,0,0,0};
}


// Count the number of bits in a row that are the same as bit in starting index.
size_t _count_streak(const std::bitset<MAX_BITS_WORD>& morse, size_t start){
    size_t result = 0;
    bool target = morse[start];
    while(target == morse[start]){
        ++start;
        ++result;
        if (MAX_BITS_WORD == start){
            break;
        }
    }
    return result;
}




// Converts a SINGLE word from morse to english.
// Empty morse converts to empty string.
std::array<char, MAX_CHARS_WORD> morse_to_english(const std::bitset<MAX_BITS_WORD>& morse){
    std::array<size_t, BEEPS_LETTER> character = { 0 };
    std::array<char, MAX_CHARS_WORD> word = { 0 };

    size_t bitset_index = 0;
    size_t character_index = 0;
    size_t word_index= 0;

    size_t low_count = END_CHARACTER;

    if (!morse.any()){
        return word;
    }
    while(!morse[bitset_index]){
        ++bitset_index;
    }

    // Procedure to retrieve a character
    while (low_count == END_CHARACTER)
    {
        do {
            size_t beep_length = _count_streak(morse, bitset_index);
            character[character_index++] = beep_length;
            bitset_index += beep_length;
            low_count = _count_streak(morse, bitset_index);
            bitset_index += low_count;
        } while(1 == low_count);
        word[word_index++] = _ITU_to_english(character);
        character = { 0 };
        character_index = 0;
    }
    return word;
}


// Converts a SINGLE word from english to morse.
std::bitset<MAX_BITS_WORD> english_to_morse(const std::array<char, MAX_CHARS_WORD>& word){
    size_t bitset_index = 0;
    size_t word_index = 0;
    std::bitset<MAX_BITS_WORD> morse;


    while(word[word_index] != '\0'){
        char ch = word[word_index++];
        std::array<size_t, BEEPS_LETTER> ch_morse = _english_to_ITU(ch);

        for (size_t beep = 0 ; beep < BEEPS_LETTER ; ++beep){
            for (size_t ones = 0 ; ones < ch_morse[beep] ; ++ones){
                morse[bitset_index++] = true;
            }
            if (BEEPS_LETTER == beep + 1 || 0 == ch_morse[beep + 1]){
                break;
            }   else    {
                morse[bitset_index++] = false;
            }
        }

        for (size_t i = 0 ; i < END_CHARACTER ; ++i){
            morse[bitset_index++] = false;
        }
    }
    return morse;
}


}
```

## src/pin_reader.cpp
```c
// #include <zephyr/sys_clock.h>

#include <array>
#include <bitset>

#include "pin_reader.hpp"


PinReader::PinReader(uint32_t pin, const struct device * dev, k_msgq* p1, k_msgq * p2):
	m_pin_number(pin), m_device(dev), m_msgq_1(p1), m_msgq_2(p2),
    m_current_word(), m_low_count(0), m_index(0){}


void PinReader::callback(){

    int pin_status = gpio_pin_get(m_device, m_pin_number);
    if(pin_status){
        for (size_t i = 0 ; i < m_low_count ; ++i){
            m_current_word[m_index++] = false;
        }
        m_low_count = 0;
        m_current_word[m_index++] = true;
    }   else{
        ++m_low_count;
    }

    if(morse::END_WORD == m_low_count){
        _transmit_word(morse::morse_to_english(m_current_word));  
        m_current_word.reset();
        m_low_count = 0;
        m_index = 0;     
    }
}


void PinReader::_transmit_word(const std::array<char, morse::MAX_CHARS_WORD>& word){

    k_msgq_put (m_msgq_1, word.data(), K_NO_WAIT);
    k_msgq_put (m_msgq_2, word.data(), K_NO_WAIT);
}
```

## src/uart_publisher.cpp
```c
#include <array>
#include <cstring>

#include <zephyr/drivers/uart.h>

#include "morse.hpp"

#include "uart_publisher.hpp"

UartPublisher::UartPublisher(const struct device * dev, k_msgq* p1):
m_dev(dev), m_msgq(p1) {
}

// static const struct device * gpiob = DEVICE_DT_GET(DT_NODELABEL(gpiob));

void UartPublisher::callback(){
    std::array<char, morse::MAX_CHARS_WORD> received_word = { 0 };
    k_msgq_get(m_msgq, received_word.data(), K_NO_WAIT);
    size_t length = std::strlen(received_word.data());
    
    for (size_t i = 0; i < length; i++) {
		uart_poll_out(m_dev, received_word.data()[i]);
	}
}
```
